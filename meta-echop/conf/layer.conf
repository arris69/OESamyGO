## meta-echop/conf/layer.conf
```bitbake
# We have a conf and classes directory, add to BBPATH
#BBPATH := "${BBPATH}:${LAYERDIR}"
BBPATH .= ":${LAYERDIR}"
# We have a packages directory, add to BBFILES
BBFILES := "${BBFILES} ${LAYERDIR}/recipes-*/*/*.bb"
BBFILES += " ${LAYERDIR}/recipes-*/*/*.bbappend"

BBFILE_COLLECTIONS += "echop"
BBFILE_PATTERN_echop := "^${LAYERDIR}/"
BBFILE_PRIORITY_echop = "6"
```

## meta-echop/conf/machine/echop.conf
```bitbake
TARGET_ARCH = "arm"

DEFAULTTUNE = "cortexa8hf"
TUNE_FEATURES = "armv7a vfp3 cortexa8"

require conf/machine/include/tune-cortexa8.inc

TCMODE = "external-armv7a8v2r2"
TCLIBC = "external-armv7a8v2r2-toolchain"

KERNEL_MODULE_VERSION="0136" 
KERNEL_VERSION = "2.6.35.13"
PREFERRED_PROVIDER_virtual/kernel = "linux-echop"
KERNEL_IMAGETYPE = "uImage"
MACHINE_FEATURES = "kernel26 ext2 vfat usbhost usbgadget"

DISTRO_FEATURES += "kernel26 opengl"
LICENSE_FLAGS_WHITELIST = "commercial"
```

## meta-foxp/conf/layer.conf
```bitbake
# We have a conf and classes directory, add to BBPATH
#BBPATH := "${BBPATH}:${LAYERDIR}"
BBPATH .= ":${LAYERDIR}"
# We have a packages directory, add to BBFILES
BBFILES := "${BBFILES} ${LAYERDIR}/recipes-*/*/*.bb"
BBFILES += " ${LAYERDIR}/recipes-*/*/*.bbappend"

BBFILE_COLLECTIONS += "foxp"
BBFILE_PATTERN_foxp := "^${LAYERDIR}/"
BBFILE_PRIORITY_foxp = "6"
```

## meta-foxp/conf/machine/foxp.conf
```bitbake
TARGET_ARCH = "arm"

DEFAULTTUNE = "cortexa15hf"
# too much for jpeg (its ok if no neon?)
#TUNE_FEATURES = "armv7a vfp neon cortexa8"
TUNE_FEATURES = "armv7a vfp4 cortexa15"

require conf/machine/include/tune-cortexa15.inc

# PREFERRED_VERSION_external-vdlinux-toolchain = "armv7a15v3r1"
# PREFERRED_VERSION_external-vdlinux-toolchain = "v7a15v3r1"
TCMODE = "external-armv7a15v3r1"
TCLIBC = "external-armv7a15v3r1-toolchain"

PREFERRED_VERSION_linux-libc-headers = "3.0.20"
PREFERRED_VERSION_glibc = "2.14.1"
PREFERRED_VERSION_glibc-initial = "2.14.1"
PREFERRED_VERSION_glibc-intermediate = "2.14.1"

KERNEL_MODULE_VERSION="0147" 
KERNEL_VERSION = "3.0.20"
PREFERRED_PROVIDER_virtual/kernel = "linux-foxp"
KERNEL_IMAGETYPE = "uImage"
```

## meta-mst12/conf/machine/mst12.conf
```bitbake
TARGET_ARCH = "arm"
DEFAULTTUNE = "armv7a"
PACKAGE_ARCH="mst12"
require conf/machine/include/tune-cortexa8.inc

TCMODE = "external-armv7a8v3r1"
TCLIBC = "external-armv7a8v3r1-toolchain"

KERNEL_MODULE_VERSION="0147" 
KERNEL_VERSION = "3.0.20"
PREFERRED_PROVIDER_virtual/kernel = "linux-mst12"
KERNEL_IMAGETYPE = "uImage"
```

## meta-mst5/conf/distro/include/image-mst5.inc
```bitbake
DEPENDS += "mc" 
# samygoso apache2 dropbear mc patch usbutils strace setserial diffutils gawk grep groff gzip curl wget samba ser2net lua hexedit vim xclock oscam qemu v4l-utils yavta"
```

## meta-mst5/conf/distro/include/tcmode-external-mips-linux.inc
```bitbake
#
# Configuration to use external toolchain
#
 
#TOOLCHAIN_PATH_ADD = "${EXTERNAL_TOOLCHAIN}/bin:"
TARGET_SYS="mips-linux-gnu"
EXTERNAL_TOOLCHAIN = "${EXTERNAL_CROSS_DIR}/VDLinux-mips34kc"
TOOLCHAIN_PATH_ADD = "${EXTERNAL_TOOLCHAIN}/bin:"
PATH =. "${TOOLCHAIN_PATH_ADD}"

CSL_TARGET_SYS = "${TARGET_SYS}"

TARGET_PREFIX = "${CSL_TARGET_SYS}-"

PREFERRED_PROVIDER_linux-libc-headers = "external-mips-linux-toolchain"
PREFERRED_PROVIDER_linux-libc-headers-dev = "external-mips-linux-toolchain"
PREFERRED_PROVIDER_virtual/${TARGET_PREFIX}gcc = "external-mips-linux-toolchain"
PREFERRED_PROVIDER_virtual/${TARGET_PREFIX}gcc-initial = "external-mips-linux-toolchain"
PREFERRED_PROVIDER_virtual/${TARGET_PREFIX}gcc-intermediate = "mips-linux"
PREFERRED_PROVIDER_virtual/${TARGET_PREFIX}g++ = "external-mips-linux-toolchain"
PREFERRED_PROVIDER_virtual/${TARGET_PREFIX}binutils = "external-mips-linux-toolchain"
PREFERRED_PROVIDER_virtual/${TARGET_PREFIX}libc-for-gcc = "external-mips-linux-toolchain"
PREFERRED_PROVIDER_virtual/${TARGET_PREFIX}libc-initial = "external-mips-linux-toolchain"
PREFERRED_PROVIDER_virtual/${TARGET_PREFIX}compilerlibs = "external-mips-linux-toolchain"
PREFERRED_PROVIDER_libgcc = "external-mips-linux-toolchain"
PREFERRED_PROVIDER_eglibc = "external-mips-linux-toolchain"
PREFERRED_PROVIDER_virtual/libc = "external-mips-linux-toolchain"
PREFERRED_PROVIDER_virtual/libintl = "mips-linux"
PREFERRED_PROVIDER_virtual/libiconv = "external-mips-linux-toolchain"
PREFERRED_PROVIDER_glibc-thread-db = "external-mips-linux-toolchain"
PREFERRED_PROVIDER_virtual/linux-libc-headers = "external-mips-linux-toolchain"
PREFERRED_PROVIDER_virtual/linux-libc-headers-dev = "external-mips-linux-toolchain"
PREFERRED_PROVIDER_gdbserver ??= "external-mips-linux-toolchain"

# No need to re-compile the locale files
GLIBC_INTERNAL_USE_BINARY_LOCALE = "precompiled"
ENABLE_BINARY_LOCALE_GENERATION = ""
TARGET_LDFLAGS_prepend = " -L${EXTERNAL_TOOLCHAIN}/${TARGET_SYS}/lib -Wl,-rpath-link,${EXTERNAL_TOOLCHAIN}/${TARGET_SYS}/lib "

TOOLCHAIN_OPTIONS = " --sysroot=${STAGING_DIR_HOST}"

def csl_target_core(d):
    coredata = {
        'armv7a-vfp-neon': 'armv7-a-neon',
        'mips': 'mips32',
        'mipsel': 'el',
        'ppce500': 'te500v1',
        'ppce500mc': 'te500mc',
        'ppce500v2': 'te500v2',
        'ppce600': 'te600'
    }
    return coredata.get(d.getVar('TUNE_PKGARCH', True), '')

CSL_TARGET_CORE = "el"



addhandler toolchain_setup
toolchain_setup[eventmask] = "bb.event.BuildStarted"
python toolchain_setup () {
    import errno

    d = e.data
    d = d.createCopy()
    d.finalize()

    tarprefix = d.expand('${TARGET_PREFIX}')
    files = []
    if tarprefix == "mips-linux-gnu-":
        files.append((tarprefix + "ld", tarprefix + "ld.bfd"))

    if len(files) > 0:
        ext_bindir = d.expand('${EXTERNAL_TOOLCHAIN}/bin')
        loc_bindir = d.getVar('STAGING_BINDIR_TOOLCHAIN', True)
        bb.utils.mkdirhier(loc_bindir)
        for f in files:
            source = os.path.join(ext_bindir, f[0])
            dest = os.path.join(loc_bindir, f[1])
            try:
                os.symlink(source, dest)
            except OSError as exc:
                if exc.errno == errno.EEXIST:
                    break
                bb.fatal("Unable to populate toolchain binary symlink for %s: %s" % (f[0], f[1]))
}

require conf/distro/include/armv7a_sam-versions.inc
```

## meta-mst5/conf/machine/mst5.conf
```bitbake
TARGET_ARCH = "mipsel"
DEFAULTTUNE = "mips32el"


require conf/machine/include/tune-mips32.inc

TUNE_CCARGS="-mel -mglibc -march=34kc " 
TCMODE = "external-mips-linux"
TCLIBC = "external-mips-linux-toolchain"

KERNEL_MODULE_VERSION="0147" 
KERNEL_VERSION = "3.0.20"
PREFERRED_PROVIDER_virtual/kernel = "linux-mst5"
#KERNEL_IMAGETYPE = "uImage"
```

## meta-samygo/conf/distro/include/samygo_rdepend.inc
```bitbake
MACHINE_ESSENTIAL_EXTRA_RDEPENDS += "apache2 dropbear mc patch usbutils strace setserial diffutils gawk grep groff gzip curl wget samba ser2net lua php hexedit vim xclock oscam qemu "
```

## meta-samygo/conf/distro/include/tcmode-external-armv7a8v2r2.inc
```bitbake
#
# Configuration to use external toolchain
#
 
#TOOLCHAIN_PATH_ADD = "${EXTERNAL_TOOLCHAIN}/bin:"
EXTERNAL_TOOLCHAIN = "${EXTERNAL_CROSS_DIR}/arm-v7a8v2r2"
TOOLCHAIN_PATH_ADD = "${EXTERNAL_TOOLCHAIN}/bin:"
PATH =. "${TOOLCHAIN_PATH_ADD}"

CSL_TARGET_SYS_armv7a ?= "arm-v7a8v2r2-linux-gnueabi"
CSL_TARGET_SYS = "${TARGET_SYS}"

TARGET_PREFIX = "${CSL_TARGET_SYS}-"

PREFERRED_PROVIDER_linux-libc-headers = "external-vdlinux-toolchain"
PREFERRED_PROVIDER_linux-libc-headers-dev = "external-vdlinux-toolchain"
PREFERRED_PROVIDER_virtual/${TARGET_PREFIX}gcc = "external-vdlinux-toolchain"
PREFERRED_PROVIDER_virtual/${TARGET_PREFIX}gcc-initial = "external-vdlinux-toolchain"
PREFERRED_PROVIDER_virtual/${TARGET_PREFIX}gcc-intermediate = "external-vdlinux-toolchain"
PREFERRED_PROVIDER_virtual/${TARGET_PREFIX}g++ = "external-vdlinux-toolchain"
PREFERRED_PROVIDER_virtual/${TARGET_PREFIX}binutils = "external-vdlinux-toolchain"
PREFERRED_PROVIDER_virtual/${TARGET_PREFIX}libc-for-gcc = "external-vdlinux-toolchain"
PREFERRED_PROVIDER_virtual/${TARGET_PREFIX}libc-initial = "external-vdlinux-toolchain"
PREFERRED_PROVIDER_virtual/${TARGET_PREFIX}compilerlibs = "external-vdlinux-toolchain"
PREFERRED_PROVIDER_libgcc = "external-vdlinux-toolchain"
PREFERRED_PROVIDER_eglibc = "external-vdlinux-toolchain"
PREFERRED_PROVIDER_virtual/libc = "external-vdlinux-toolchain"
PREFERRED_PROVIDER_virtual/libintl = "external-vdlinux-toolchain"
PREFERRED_PROVIDER_virtual/libiconv = "external-vdlinux-toolchain"
PREFERRED_PROVIDER_glibc-thread-db = "external-vdlinux-toolchain"
PREFERRED_PROVIDER_virtual/linux-libc-headers = "external-vdlinux-toolchain"
PREFERRED_PROVIDER_virtual/linux-libc-headers-dev = "external-vdlinux-toolchain"
PREFERRED_PROVIDER_gdbserver ??= "external-vdlinux-toolchain"

# No need to re-compile the locale files
GLIBC_INTERNAL_USE_BINARY_LOCALE = "precompiled"
ENABLE_BINARY_LOCALE_GENERATION = ""

TOOLCHAIN_OPTIONS = " --sysroot=${STAGING_DIR_HOST}"

# Default sysroot is inside the ARM v7-A toolchain in the '<CSL_TARGET_SYS>/libc' (no debug-root)
EXTERNAL_TOOLCHAIN_SYSROOT_armv7a ??= "${EXTERNAL_TOOLCHAIN}/${CSL_TARGET_SYS}/libc"
EXTERNAL_TOOLCHAIN_DBGROOT_armv7a ??= ""

# Default sysroot is inside the toolchain in the '<CSL_TARGET_SYS>/sys-root'
EXTERNAL_TOOLCHAIN_SYSROOT_armv7a ??= "${EXTERNAL_TOOLCHAIN}/${CSL_TARGET_SYS}/libc"
EXTERNAL_TOOLCHAIN_DBGROOT_armv7a ??= "${EXTERNAL_TOOLCHAIN}/${CSL_TARGET_SYS}/debug-root"

addhandler toolchain_setup
toolchain_setup[eventmask] = "bb.event.BuildStarted"
python toolchain_setup () {
    import errno

    d = e.data
    d = d.createCopy()
    d.finalize()

    tarprefix = d.expand('${TARGET_PREFIX}')
    files = []
    if tarprefix == "arm-v7a8v2r2-linux-gnueabi-":
        files.append((tarprefix + "ld", tarprefix + "ld.bfd"))

    if len(files) > 0:
        ext_bindir = d.expand('${EXTERNAL_TOOLCHAIN}/bin')
        loc_bindir = d.getVar('STAGING_BINDIR_TOOLCHAIN', True)
        bb.utils.mkdirhier(loc_bindir)
        for f in files:
            source = os.path.join(ext_bindir, f[0])
            dest = os.path.join(loc_bindir, f[1])
            try:
                os.symlink(source, dest)
            except OSError as exc:
                if exc.errno == errno.EEXIST:
                    break
                bb.fatal("Unable to populate toolchain binary symlink for %s: %s" % (f[0], f[1]))
}

require conf/distro/include/armv7a_sam-versions.inc
```

## meta-samygo/conf/distro/samygo.conf
```bitbake
#@TYPE: Distribution
#@NAME: SamyGO
#@DESCRIPTION: Embedded Linux Distribution Configuration for Samsung's Devices
MAINTAINER = "SamyGO Team"

OE_TERMINAL ?= "auto"
DISTRO_NAME ?= "samygo"
DISTRO_VERSION = "2.0"
DISTRO_TYPE ?= "release"
BUILD_VERSION = "1"

LICENSE_FLAGS_WHITELIST = "commercial"

#EXTRA_IMAGE_FEATURES = "debug-tweaks"
USER_CLASSES = "buildstats"

FEED_NAME ?= "${DISTRO_NAME}-${DISTRO_VERSION}"
DISTRO_FEED_URI ?= "http://feeds.mynonpublic.com/${DISTRO_VERSION}/${MACHINE}"
DISTRO_FEED_PREFIX ?= "openarp"

IMAGE_VERSION = "${DISTRO_VERSION}"
IMAGE_NAME = "${DISTRO_NAME}-${IMAGE_VERSION}-${MACHINE}-${DATE}"
IMAGE_ROOTFS = "${TMPDIR}/rootfs"
IMAGE_LINK_NAME = ""

CACHE ?= "${TMPDIR}/cache/${LIBC}/${MACHINE}"
DEPLOY_DIR ?= "${TMPDIR}/deploy/${LIBC}"
DEPLOY_DIR_IMAGE = "${DEPLOY_DIR}/images"
INHERIT += "debian"
INHERIT += "package_ipk"

PREFERRED_PKG_FORMAT ?= "ipk"

IPKG_VARIANT = "opkg"
INHERIT += "rm_work"
IMAGE_FSTYPES = "jffs2 squashfs tar.bz2"

#PREFERRED_PROVIDER_virtual/update-alternatives = "opkg"
#PREFERRED_PROVIDER_virtual/update-alternatives-native = "opkg-native"

#VIRTUAL-RUNTIME_dev_manager = "busybox-mdev"
VIRTUAL-RUNTIME_login_manager = "busybox"
VIRTUAL-RUNTIME_init_manager = "sysvinit"
VIRTUAL-RUNTIME_init_manager = "busybox"
VIRTUAL-RUNTIME_initscripts = "initscripts"

PREFERRED_VERSION_initscripts = "0.03.3"
#PREFERRED_PROVIDER_virtual/librpc = "external-armv7a15v3r1-toolchain"

PREFERRED_PROVIDER_jpeg = "jpeg"
PREFERRED_PROVIDER_jpeg-native = "jpeg-native"
PREFERRED_PROVIDER_libfribidi = "libfribidi"
PREFERRED_PROVIDER_openssl = "openssl"
PREFERRED_PROVIDER_libcrypto = "openssl"
PREFERRED_PROVIDER_libssl = "openssl"
PREFERRED_PROVIDER_ntp = "ntp"

PREFERRED_PROVIDERS += "virtual/${TARGET_PREFIX}gcc-initial:gcc-cross-initial"
PREFERRED_PROVIDERS += "virtual/${TARGET_PREFIX}gcc-intermediate:gcc-cross-intermediate"
PREFERRED_PROVIDERS += "virtual/${TARGET_PREFIX}gcc:gcc-cross"
PREFERRED_PROVIDERS += "virtual/${TARGET_PREFIX}g++:gcc-cross"

# build some core libs with better compiler optimization for better performance
O3_OPT = "-O3 -pipe ${DEBUG_FLAGS}"
FULL_OPTIMIZATION_pn-flac = "${O3_OPT}"
FULL_OPTIMIZATION_pn-jpeg = "${O3_OPT}"
FULL_OPTIMIZATION_pn-lame = "${O3_OPT}"
FULL_OPTIMIZATION_pn-liba52 = "${O3_OPT}"
FULL_OPTIMIZATION_pn-libdca = "${O3_OPT}"
FULL_OPTIMIZATION_pn-libgcrypt = "${O3_OPT}"
FULL_OPTIMIZATION_pn-libmad = "${O3_OPT}"
FULL_OPTIMIZATION_pn-libogg = "${O3_OPT}"
FULL_OPTIMIZATION_pn-libpng = "${O3_OPT}"
FULL_OPTIMIZATION_pn-libsamplerate = "${O3_OPT}"
FULL_OPTIMIZATION_pn-libvorbis = "${O3_OPT}"
FULL_OPTIMIZATION_pn-tremor = "${O3_OPT}"
FULL_OPTIMIZATION_pn-zlib = "${O3_OPT}"

PYTHON_BASEVERSION ?= "2.7"
PREFERRED_VERSION_python ?= "2.7.3"
PREFERRED_VERSION_python-native ?= "2.7.3"



# Force the older version of liberation-fonts until we fix the fontforge issue
#PREFERRED_VERSION_liberation-fonts ?= "1.04"


#PREFERRED_VERSION_netatalk ?= "2.2.3"

DISTRO_FEATURES = "x11 alsa argp bluetooth ext2 largefile xattr nfs appletalk smbfs zeroconf opengl"
DISTRO_FEATURES += " ${DISTRO_FEATURES_LIBC}"
#DISTRO_FEATURES = "nfs alsa"
#DISTRO_FEATURES += "largefile"
# Following features are for ARM and E500 based machines
#DISTRO_FEATURES += "eabi"

QA_LOGFILE = "${TMPDIR}/qa.log"

OEINCLUDELOGS ?= "yes"
KERNEL_CONSOLE ?= "ttyS0"

BB_GENERATE_MIRROR_TARBALLS ??= "0"

NO32LIBS ??= "1"

# Missing checksums should raise an error
BB_STRICT_CHECKSUM = "0"

IMAGE_LINGUAS = ""
LIMIT_BUILT_LOCALES = "POSIX"
LANGUAGES = "c,c++"
# ENABLE_BINARY_LOCALE_GENERATION controls the generation of binary locale
# packages at build time using qemu-native. Disabling it (by setting it to 0)
# will save some build time at the expense of breaking i18n on devices with
# less than 128MB RAM.
#ENABLE_BINARY_LOCALE_GENERATION = "0"

GCCVERSION ?= "linaro-4.6"
SDKGCCVERSION ?= "linaro-4.6"
EXTERNAL_TOOLCHAIN ?= "/extdisk/yocto/88/arm-fsl-linux-gnueabi/4.6.2"
TCMODE ?= "default"
TCLIBC = "glibc"
TCLIBCAPPEND = ""

# Drop unused PACKAGE_EXTRA_ARCHS
PACKAGE_EXTRA_ARCHS = "${TUNE_PKGARCH}"
#PACKAGE_EXTRA_ARCHS_tune-cortexa15t-neon = "${PACKAGE_EXTRA_ARCHS_tune-armv7at-neon} cortexa15-vfp cortexa15-vfp-neon cortexa15t2-vfp cortexa15t2-vfp-neon"
#
## VFP Tunes
#AVAILTUNES
```

## meta-samygo/conf/layer.conf
```bitbake
# We have a conf and classes directory, add to BBPATH
#BBPATH := "${BBPATH}:${LAYERDIR}"
BBPATH .= ":${LAYERDIR}"
# We have a packages directory, add to BBFILES
BBFILES := "${BBFILES} ${LAYERDIR}/recipes-*/*/*.bb"
BBFILES += " ${LAYERDIR}/recipes-*/*/*.bbappend"

BBFILE_COLLECTIONS += "samygo"
BBFILE_PATTERN_samygo := "^${LAYERDIR}/"
BBFILE_PRIORITY_samygo = "6"
```
